## conf/machine/j120f.conf
```bitbake
#@TYPE: Machine
#@NAME: j120f

#@DESCRIPTION: Machine configuration for j120f systems

PREFERRED_PROVIDER_virtual/xserver ?= "xserver-xorg"
XSERVER ?= "xserver-xorg \
           xf86-input-evdev \
           xf86-input-mouse \
           xf86-video-fbdev \
           xf86-input-keyboard"

#MACHINE_EXTRA_RRECOMMENDS = " kernel-modules kernel-devicetree"
MACHINE_EXTRA_RRECOMMENDS = " j120f-firmware lrzsz setserial rpm minicom nano chromium-x11 coreutils mesa nautilus gedit gpicview gparted evince lxdm gnome-bluetooth gnome-system-monitor xfce4-terminal xfce4-screenshooter htop xarchiver mousepad blueman vim xfce4-battery-plugin"

#EXTRA_IMAGEDEPENDS += "u-boot"

DEFAULTTUNE ?= "cortexa7hf-neon-vfpv4"
include conf/machine/include/tune-cortexa7.inc

IMAGE_FSTYPES += "tar"

SERIAL_CONSOLE = "115200 ttySAC2"

#ASSUME_PROVIDED += " virtual/kernel"


#KERNEL_IMAGETYPE = "zImage"
#KERNEL_DEVICETREE = "am335x-bone.dtb am335x-boneblack.dtb"
#KERNEL_EXTRA_ARGS += "LOADADDR=${UBOOT_ENTRYPOINT}"

#SPL_BINARY = "MLO"
#UBOOT_SUFFIX = "img"
#UBOOT_MACHINE = "am335x_evm_config"
#UBOOT_ENTRYPOINT = "0x80008000"
#UBOOT_LOADADDRESS = "0x80008000"

MACHINE_FEATURES = " usbgadget usbhost vfat alsa bluetooth phone screen touchscreen wifi "

DISTRO_FEATURES_append = " opengl systemd pam polkit"

#IMAGE_BOOT_FILES ?= "u-boot.${UBOOT_SUFFIX} MLO"
```
